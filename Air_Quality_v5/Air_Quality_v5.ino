/*
 Intelligent system for indoor air quality control
 control fan motor outdoor and Air mitsubishi
 Automatic AC Temperature Controller using Arduino
 Arduino Smart Home Automation
 sensor  
 A0     -MQ2 gas
 A1     rx2 -CO2 MH-Z14A
 A2     humidity
 A3     Analog temp ,
 pin 9  IR LED
 i2c    OLED
 i2c    Tiny RTC
 spi    microSD card
 tx3    esp8266 ,data 4 byte
*/
#include <SPI.h>
#include <Wire.h>
#include <SD.h>
#include <IRremote.h>
IRsend irsend;
File myFile;
////////////////////////////////////////////////////////////////////////
int khz = 38; // 38kHz carrier frequency for the NEC protocol
int airsend = 0;
uint16_t irSignal30[583] = {3402, 1754,  384, 1336,  410, 1320,  384, 478,  386, 480,  384, 478,  354,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 482,  356};  // UNKNOWN B6ED6E37
uint16_t irSignal29[583] = {3346, 1810,  354, 1370,  372, 1358,  352, 508,  354, 512,  354, 508,  354,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 506,  346};  // UNKNOWN 31A86B36
uint16_t irSignal28[583] = {3348, 1808,  432, 1292,  374, 1356,  428, 434,  430, 434,  434, 428,  434,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 508,  324};  // UNKNOWN CA22CAF
uint16_t irSignal26[583] = {3374, 1780,  326, 1396,  382, 1324,  382, 506,  356, 510,  356, 508,  346,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 506,  348};  // UNKNOWN F2D0AA67
uint16_t irSignal24[583] = {3348, 1808,  324, 1400,  356, 1368,  326, 542,  348, 522,  354, 506,  324,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 542,  356};  // UNKNOWN 963639DF
//////////////////////////////////////////////////////////////////////
#include <Adafruit_GFX.h>
#include <Adafruit_SSD1306.h>
#define SCREEN_WIDTH 128 // OLED display width, in pixels
#define SCREEN_HEIGHT 32 // OLED display height, in pixels
// Declaration for an SSD1306 display connected to I2C (SDA, SCL pins)
#define OLED_RESET     4 // Reset pin # (or -1 if sharing Arduino reset pin)
Adafruit_SSD1306 display(SCREEN_WIDTH, SCREEN_HEIGHT, &Wire, OLED_RESET);
////////////////////////////////////////////////////////////////////////
#define DS1307_I2C_ADDRESS 0x68 // the I2C address of Tiny RTC
byte second, minute, hour, dayOfWeek, dayOfMonth, month, year;
// Convert normal decimal numbers to binary coded decimal
byte decToBcd(byte val)
{
return ( (val/10*16) + (val%10) );
}
// Convert binary coded decimal to normal decimal numbers
byte bcdToDec(byte val)
{
return ( (val/16*10) + (val%16) );
}
// Function to set the currnt time, change the second&minute&hour to the right time
void setDateDs1307()
{
second =45;
minute = 5;
hour = 8;
dayOfWeek = 0;//0 = Sunday 1 = Monday 2 = Tuesday 3 = Wednesday 4 = Thursday 5 = Friday 6 = Saturday
dayOfMonth =12;
month =4;
year= 63;
Wire.beginTransmission(DS1307_I2C_ADDRESS);
Wire.write(decToBcd(0));
Wire.write(decToBcd(second)); // 0 to bit 7 starts the clock
Wire.write(decToBcd(minute));
Wire.write(decToBcd(hour)); // If you want 12 hour am/pm you need to set
// bit 6 (also need to change readDateDs1307)
Wire.write(decToBcd(dayOfWeek));
Wire.write(decToBcd(dayOfMonth));
Wire.write(decToBcd(month));
Wire.write(decToBcd(year));
Wire.endTransmission();
}
// Function to gets the date and time from the ds1307 and prints result
void getDateDs1307()
{
// Reset the register pointer
Wire.beginTransmission(DS1307_I2C_ADDRESS);
Wire.write(decToBcd(0));
Wire.endTransmission();
Wire.requestFrom(DS1307_I2C_ADDRESS, 7);
second = bcdToDec(Wire.read() & 0x7f);
minute = bcdToDec(Wire.read());
hour = bcdToDec(Wire.read() & 0x3f); // Need to change this if 12 hour am/pm
dayOfWeek = bcdToDec(Wire.read());
dayOfMonth = bcdToDec(Wire.read());
month = bcdToDec(Wire.read());
year = bcdToDec(Wire.read());
//Serial.print(hour, DEC);
//Serial.print(":");
//Serial.print(minute, DEC);
//Serial.print(":");
//Serial.print(second, DEC);
//Serial.print(" ");
//Serial.print(month, DEC);
//Serial.print("/");
//Serial.print(dayOfMonth, DEC);
//Serial.print("/");
//Serial.print(year,DEC);
//Serial.print(" ");
//Serial.println();
//Serial.print("Day of week:");
}
/////////////////////////////////////////////////////////////////////
int co = 11;
float MQ2gas = 11.0;
int co2 = 1237;
float Carbondioxied = 1237.0;
float t1 = 26.0;
float h1 = 42.0;
float humidityf = 42.0;

float kk = 0.1;

byte addArray[] = { 0xFF, 0x01, 0x86, 0x00, 0x00, 0x00, 0x00, 0x00, 0x79 };
char dataValue[9];
byte dataValuee[3];
String dataString = "";

int print_1s = 0;
int save_1m = 0;
unsigned long time1;

void setup() {
  // initialize serial communications at 9600 bps:
  Serial.begin(115200);
  Serial2.begin(9600);
  Serial3.begin(115200);
  Serial.println("Air_Quality_v5");
  //setDateDs1307(); //Set current time;
  Serial.println("Set current time");
   Serial.print("Initializing SD card...");
  if (!SD.begin(4)) {
    Serial.println("initialization failed!");
    return;
  }
  Serial.println("initialization done.");
    // SSD1306_SWITCHCAPVCC = generate display voltage from 3.3V internally
  if(!display.begin(SSD1306_SWITCHCAPVCC, 0x3C)) { // Address 0x3C for 128x32
    Serial.println(F("SSD1306 allocation failed"));
    for(;;); // Don't proceed, loop forever
  }
  // Show initial display buffer contents on the screen --
  // the library initializes this with an Adafruit splash screen.
  display.display();
  delay(2000); // Pause for 2 seconds
  // Clear the buffer
  display.clearDisplay();
  // Draw a single pixel in white
  display.drawPixel(10, 10, SSD1306_WHITE);
  // Show the display buffer on the screen. You MUST call display() after
  // drawing commands to make them visible on screen!
  display.clearDisplay();
  display.setTextSize(1);             // Normal 1:1 pixel scale
  display.setTextColor(SSD1306_WHITE);        // Draw white text
  display.setCursor(0,0);             // Start at top-left corner
  display.print(" Air_Quality_v4 ");
  display.display();
  delay(2000);
  myFile = SD.open("AIR1.txt", FILE_WRITE);
    if (myFile) {
     //time1 = millis();
      getDateDs1307();//get the time data from tiny RTC
      myFile.print(hour, DEC);
      myFile.print(":");
      myFile.print(minute, DEC);
      myFile.print(":");
      myFile.print(second, DEC);
      myFile.print(" ");
      myFile.print(month, DEC);
      myFile.print("/");
      myFile.print(dayOfMonth, DEC);
      myFile.print("/");
      myFile.print(year,DEC);
     myFile.print("\t");
     myFile.print(MQ2gas);
     myFile.print("\t");
     myFile.print(Carbondioxied);
     myFile.print("\t");
     myFile.print(t1);
     myFile.print("\t");
     myFile.println(humidityf);
     myFile.close();
    }
}

void loop() {
  //Read MH-Z14 CO2 NDIR Gas Sensor 
  Serial2.write(addArray, 9);//Warm-up time 3 min
  Serial2.readBytes(dataValue, 9);
  //Serial3.readBytes(dataValuee, 3);
    if (Serial3.available() >= 3) {
    dataValuee[0] = Serial3.read();
    dataValuee[1] = Serial3.read();
    dataValuee[2] = Serial3.read();
  }
  int resHigh = (int) dataValue[2];
  int resLow  = (int) dataValue[3];
  int pulse = (256*resHigh)+resLow;
  //dataString = String(pulse);
 
 //Grove - Gas Sensor(MQ2)detecting H2, LPG, CH4, CO, Alcohol, Smoke
  co = analogRead(A0);
  //co2 = analogRead(A1);
int V2 = analogRead(A3);
int Vo = map(V2, 0, 1023, 1023, 0);
int hg = analogRead(A2);//analogRead(A2)*5.0*33.33/1023.0
    h1 = ((30.855*(hg/204.6))+8.35);//((30.855*(rhsense/204.6))-11.504);
float R1 = 10900; // value of R1 on board
float logR2, R2;
float c1 = 0.001129148, c2 = 0.000234125, c3 = 0.0000000876741; //steinhart-hart
  R2 = R1 * (1023.0 / (float)Vo - 1.0); //calculate resistance on thermistor
  logR2 = log(R2);
  t1 = (1.0 / (c1 + c2*logR2 + c3*logR2*logR2*logR2)) - 273.15; // temperature in Kelvin
//low pass filter////////////////////////////////////////////
float filter = 0.0253;//0.0253
humidityf = humidityf + (h1 - humidityf)*0.0213;
MQ2gas = MQ2gas + (co - MQ2gas)*0.0153;
Carbondioxied = Carbondioxied + (pulse - Carbondioxied)*filter;
//////////////////////////////////////////////////////////////
if(Carbondioxied < 900){
  kk = 0.01;
}
if(Carbondioxied >= 900 && Carbondioxied < 1000){
  kk = 2.1;
}
if(Carbondioxied >= 1000 && Carbondioxied < 1200){
  kk = 4.25;
}
if(Carbondioxied >= 1200 && Carbondioxied < 1400){
  kk = 9.5;
}
if(Carbondioxied >= 1400 && Carbondioxied < 2000){
  kk = 11.6;
}
if(Carbondioxied >= 2000 && Carbondioxied < 2100){
  kk = 16.8;
}
if(Carbondioxied >= 2100){
  kk = 20.1;
}
uint16_t outputValue4=0;
if(dataValuee[1] >= 55){
  //outputValue4 = dataValuee[1]*300;
}
uint16_t outputValue1 = MQ2gas*183;//133
uint32_t outputValue3 = outputValue1 + (kk*Carbondioxied) + outputValue4;
uint16_t outputValue2 = constrain(outputValue3, 1000, 40000);//fan motor
////////////////////////////////////////////////////////////////Air Mitsu
if(airsend == 0 && hour == 11){//hour
  airsend = 1;
  irsend.sendRaw(irSignal30, sizeof(irSignal30) / sizeof(irSignal30[0]), khz);
}
if(airsend == 1 && hour == 12){//minute
  airsend = 0;
}
if(airsend == 0 && hour == 18){//minute
  airsend = 1;
  irsend.sendRaw(irSignal28, sizeof(irSignal28) / sizeof(irSignal28[0]), khz);
}
if(airsend == 1 && hour == 19){//minute
  airsend = 0;
}
if(airsend == 0 && hour == 20){//minute
  airsend = 1;
  irsend.sendRaw(irSignal26, sizeof(irSignal26) / sizeof(irSignal26[0]), khz);
}
if(airsend == 1 && hour == 21){//minute
  airsend = 0;
}

if(airsend == 0 && hour == 6){//minute
  airsend = 1;
  irsend.sendRaw(irSignal28, sizeof(irSignal28) / sizeof(irSignal28[0]), khz);
}
if(airsend == 1 && hour == 7){//minute
  airsend = 0;
}
if(airsend == 0 && hour == 9){//minute
  airsend = 1;
  irsend.sendRaw(irSignal29, sizeof(irSignal29) / sizeof(irSignal29[0]), khz);
}
if(airsend == 1 && hour == 10){//minute
  airsend = 0;
}
  //irsend.sendRaw(irSignal24, sizeof(irSignal24) / sizeof(irSignal24[0]), khz); 
///////////////////////////////////////////////////////////////
print_1s++;//20
if(print_1s >= 2){
  print_1s = 0;
  //time1 = millis();
  Serial3.write(11);
  Serial3.write(34);
  Serial3.write(outputValue2 >> 8);
  Serial3.write(outputValue2);
  // print the results to the Serial Monitor:
  //Serial.print(co);Serial.print("\t");
  Serial.print("\t");
  Serial.print(minute);Serial.print("\t");
  Serial.print(outputValue2);Serial.print("\t");
  Serial.print(MQ2gas);Serial.print("\t");
  Serial.print(pulse);Serial.print("\t");
  Serial.print(Carbondioxied);Serial.print("\t");
  Serial.print(t1);Serial.print("\t");
  Serial.println(humidityf);

  display.clearDisplay();
  display.setTextSize(1);             // Normal 1:1 pixel scale
  display.setTextColor(SSD1306_WHITE);        // Draw white text
  display.setCursor(0,0);             // Start at top-left corner
  display.print("CO  = ");
  display.println(MQ2gas);
  display.print("CO2 = ");
  display.println(Carbondioxied);
  display.print("H % = ");display.print(dataValuee[1], DEC);display.print("=");
  display.println(humidityf);//dataValue[1]
  display.print("T   = ");display.print(dataValuee[2], DEC);display.print("=");
  display.println(t1);//dataValue[2]
  display.display();
  //Serial.print("co = ");
  //Serial.print(co);
  //Serial.print("\t co2 = ");
  //Serial.print(co2);
  //Serial.print("  ");
  //Serial.print(pulse);
  //Serial.print("\t T1 = ");
  //Serial.print(t1);
  //Serial.print("\t H % = ");
  //Serial.println(h1);
}
save_1m++;
if(save_1m >= 600){
  save_1m = 0;
  myFile = SD.open("AIR3.txt", FILE_WRITE);
    if (myFile) {
     //time1 = millis();
      getDateDs1307();//get the time data from tiny RTC
      myFile.print(hour, DEC);
      myFile.print(":");
      myFile.print(minute, DEC);
      myFile.print(":");
      myFile.print(second, DEC);
      myFile.print(" ");
      myFile.print(month, DEC);
      myFile.print("/");
      myFile.print(dayOfMonth, DEC);
      myFile.print("/");
      myFile.print(year,DEC);
     myFile.print("\t");
     myFile.print(MQ2gas);
     myFile.print("\t");
     myFile.print(Carbondioxied);
     myFile.print("\t");
     myFile.print(t1);
     myFile.print("\t");
     myFile.println(humidityf);
     myFile.close();
    }
}
  // wait 2 milliseconds before the next loop for the analog-to-digital
  // converter to settle after the last reading:
  delay(100);
}
